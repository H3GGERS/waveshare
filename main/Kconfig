## main/Kconfig
```kconfig
# Main component configuration
menu "Clock / WiFi Configuration"
    config WIFI_SSID
        string "WiFi SSID"
        default "your_ssid"
        help
            SSID of the WiFi AP to connect to for NTP.

    config WIFI_PASSWORD
        string "WiFi Password"
        default "your_password"
        help
            Password of the WiFi AP.

    config CHESS_USERNAME
        string "Chess.com Username"
        default "H3GGERS"
        help
            Chess.com username used to fetch daily games.

    config CHESS_REFRESH_SECONDS
        int "Chess refresh interval (seconds)"
        range 15 3600
        default 60
        help
            Polling interval for refreshing the selected daily game board.

    config BATTERY_ADC_GPIO
        int "Battery ADC GPIO (ADC1 only)"
        range 1 10
        default 1
        help
            GPIO used to measure battery voltage through a resistor divider.
            ESP32-S3 ADC1 channels map to GPIO1..GPIO10.

    config BATTERY_DIVIDER_RTOP_OHMS
        int "Battery divider top resistor (ohms)"
        range 1 10000000
        default 100000
        help
            Top resistor from battery positive to ADC pin.

    config BATTERY_DIVIDER_RBOT_OHMS
        int "Battery divider bottom resistor (ohms)"
        range 1 10000000
        default 100000
        help
            Bottom resistor from ADC pin to GND.

    config BATTERY_FULL_MV
        int "Battery full voltage (mV)"
        range 3000 5000
        default 4200
        help
            Battery voltage considered 100%.

    config BATTERY_EMPTY_MV
        int "Battery empty voltage (mV)"
        range 2500 4500
        default 3300
        help
            Battery voltage considered 0%.

    config KEY_BUTTON_GPIO
        int "Cycle-game hardware key GPIO"
        range 0 48
        default 18
        help
            GPIO used for the on-board KEY button. A press cycles to the next
            available Chess.com daily game.
endmenu
```
